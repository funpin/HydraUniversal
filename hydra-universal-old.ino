#include <ESP8266WiFi.h> //библиотека для взаимодействия платы с wi-fi сетями
#include <ESP8266WebServer.h> //библиотека для создания веб-сервера
#include <ESP8266HTTPClient.h> 
#include <Wire.h> //библиотека для работы с шиной I2C
#include <Adafruit_BME280.h> //библиотека для работы с датчиками bme280
#include <DNSServer.h>
#include <WiFiManager.h>         
#include <ESP8266SSDP.h>
#include <aREST.h>
#include <FS.h>
#include <ArduinoJson.h> //библиотека для обработки данных
#include <ESP8266WiFiMulti.h> //библиотека для работы с множеством точек досутпа
#include <GyverOLED.h> // Библиотека для OLED экрана
#include <LiquidCrystal_I2C_mod.h> // Библиотека для LCD экрана (МОДИФИЦИРОВАННАЯ)

using namespace std;
#define PERIOD (5*60*1000) // 5 минут в миллисекундах
#define BME280_ADDRESS (0x76) //адрес для подключения датчиков bme280 через I2C

ESP8266WiFiMulti wifiMulti;
String myAP;     //режим точки доступа
String mySSID;   //флаг использования собственной точки доступа WiFi
IPAddress myIP;  //хранит IP адресс  
unsigned long oldmillis=PERIOD+PERIOD;    //затравочное ("неправильное") значение
GyverOLED<SSD1306_128x32, OLED_NO_BUFFER> oled; // Объект OLED
GyverOLED<SSD1306_128x64, OLED_NO_BUFFER> oled64; // Объект OLED без пропуска строки
LiquidCrystal_I2C lcd(0x1, 16, 2);     // Объект LCD

unsigned long when = millis();

const int wf=7; //количество сканирируемых сетей
const int wf_configs=20; //количество сохраняемых элементов в памяти
int count_wifi=20;
String ssid[wf_configs]={}; //массив имен сетей
String password[wf_configs]={}; //массив паролей сетей

String ssid_scan[wf]={};

String whoami;

String Akey;
WiFiClient wifiClient;

int rssi[wf]={}; //может принимать значения от 0 до -100 дБм (чем выше значение RSSI (ближе к 0), тем сигнал лучше (мощнее))

size_t indexAppendSsid = 0;
const char* _ssid[wf_configs] ={};
const char* _password[wf_configs] ={};

ESP8266WebServer HTTP(80);   //Web интерфейс для устройства
HTTPClient http;
WiFiServer SERVERaREST(8080);   //aREST и сервер для него
aREST rest = aREST();
File fsUploadFile;

Adafruit_BME280 bme;

String jsonConfig = "{}";      //переменная, хранящая файл конфигурации

double pressure=0; 
double temp=0; 
double hum=0; 
double mmHg=133.3; //величина для перевода паскалей в мм.рт.ст
int typeDevice = 3; // Тип найденного устройства
    // 0 - OLED
    // 1 - LCD (0x27)
    // 2 - LCD (0x?)
    // 3 - Ничего (default)

const int n=9; 
String ssidAP;     // SSID точки доступа
String passwordAP = "";     // Пароль точки доступа

static const PROGMEM uint8_t img_bitmap[] = {
  0x00, 0x00, 0x00, 0x00, 0xff, 0x7f, 0x7f, 0x66, 0x86, 0x84, 0x26, 0x26, 0x26, 0x23, 0x03, 0x13, 
  0x13, 0xd3, 0xf3, 0x3e, 0x0c, 0x06, 0x03, 0x01, 0x81, 0xc1, 0xf1, 0x39, 0x3d, 0x7f, 0x1f, 0x80, 
  0xff, 0x01, 0x01, 0x01, 0xff, 0x00, 0x7f, 0x7f, 0x3d, 0x39, 0xe3, 0xc7, 0x8b, 0x19, 0x11, 0xe7, 
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  0x00, 0x00, 0x00, 0x00, 0x00, 0x00, 0x00, 0x00, 0x00, 0x00, 0x00, 0x00, 0x00, 0x00, 0x00, 0x00
};

void setup() 
{
  Wire.begin();
  Serial.begin(115200); // инициализируем последовательный порт (для отладочных целей)

  while (!Serial);
    Serial.println("\nI2C Scanner");
    
    uint8_t error;
    uint8_t scanDevice[] = {0x3C, 0x27, 0x1};
    // 0x3C (60) - OLED
    // 0x27 - LCD
    // 0x1 - LCD (Есть 2 варианта, 2го варианта адресса нет)
 
    Serial.println("Scanning I2C device...");

    for(int address = 0; address < 2; address++ ){
        Wire.beginTransmission(scanDevice[address]);
        error = Wire.endTransmission();
    
        if (error == 0){
            typeDevice = address;
        }              
        else if (error==4) {
            Serial.print("Unknown error");
        }
    } 
    
    Serial.println("I2C detect done\n");
    Serial.print("Display found: ");
    switch (typeDevice) {
      case 0: // OLED
      {
        Serial.println("OLED (0x3C)");
        oled.init();
        oled.clear();
        oled.home();  // курсор в 0,0
        oled.println();
        oled.println("    OLED detected  ");
        oled.println("        0x3C       ");
        break;
      }
      case 1: // LCD 1
      {
        Serial.println("LCD (0x27)");
        // Модифицированная версия библиотеки LiquidCrystal_I2C_mod.h
        lcd.setAddr(0x27); // Адрес 0x27 для 1го случая
        lcd.begin();
        lcd.backlight();
        lcd.clear();
        lcd.setCursor(0,0);
        lcd.print("  LCD detected  ");
        lcd.setCursor(0,1);
        lcd.print("      0x27      ");
        break;
      }
      case 2: // LCD 2
      {
        Serial.println("LCD (0x?)");
        lcd.setAddr(0x1); // Внести адрес 0x? для 2го случая
        lcd.begin();
        lcd.backlight();
        lcd.clear();
        lcd.setCursor(0,0);
        lcd.print("  LCD detected  ");
        lcd.setCursor(0,1);
        lcd.print("      0x?      "); // Внести адрес 0x? для 2го случая
        break;
      }
      default:
      {
        Serial.println("Display definition error (main setup)");
        break;
      }
    }

  SPIFFS.begin();

  File f = SPIFFS.open("/f_config.txt", "r");
  if (!f)
  {
    Serial.print("Error:file");
    return;
  }
  else 
  {
    whoami= f.readStringUntil('\n');
    if (whoami.charAt(whoami.length()-1) == 13)
    whoami=whoami.substring(0,whoami.length()-1);

    Akey = f.readStringUntil('\n');
    if (Akey.charAt(Akey.length()-1) == 13)
    Akey=Akey.substring(0,Akey.length()-1);

    ssidAP = f.readStringUntil('\n');
    if (ssidAP.charAt(ssidAP.length()-1) == 13)
    ssidAP=ssidAP.substring(0,ssidAP.length()-1);
  }
  
  //настраиваем HTTP интерфейс
  HTTP_init();
   //запускаем SSDP сервис
  SSDP_init();

  // регистрируем в aRest функции irControl
  char* irc = new char[strlen("irc") + 1];
  strcpy(irc, "irc");
  rest.function(irc, irControl);

  // включаем aREST и сервер к нему
  AREST_init();

  //загрузка конфигурации
  LoadConfig(); 
  delay(1000);

  for(size_t i = 0; i < wf_configs; i++) {
      if (ssid[i] != "") 
      {
        count_wifi=count_wifi-1;
      }
  }

  WiFi.persistent(false);
  WiFi.mode(WIFI_STA);  //переключение моудля в режим станции
  
  for (int i=0; i<wf_configs;i++)
  {
     wifiMulti.addAP(_ssid[i],_password[i]);
  }

  ReinitWiFi(0);
  
  delay(10);
}

void loop() 
{
  switch (typeDevice) {
    case 0: // OLED
    {
      oled.init();
      oled.clear();
      oled.home();  // курсор в 0,0
      oled.print("      Hydra Lite   ");   // печатай что угодно: числа, строки, float, как Serial!
      oled.println(whoami);
      oled.print(" ");   
      if (temp>0)
      {
        oled.print("+");
      }
      else if (temp=0)
      {
        oled.print(" ");
      }
      oled.print(temp);
      oled.print(" '");
      oled.println("C");
      oled.print(" ");
      oled.print(pressure);
      oled.println(" мм рт.ст.");
      oled.print(" ");
      oled.print(hum);
      oled.print(" %      ");
      oled.print(WiFi.RSSI());
      oled.println(" дБм");
      delay(4000);
      oled.update();
      break;
    }
    case 1:
    case 2: // LCD
    {
      lcd.clear();
      lcd.setCursor(0,0);
      lcd.print("T="); lcd.print(temp,1); lcd.print((char)223); lcd.print("C ");
      lcd.print("H="); lcd.print(hum,1); lcd.print("%");
      lcd.setCursor(0,1);
      lcd.print("P="); lcd.print(pressure,1); lcd.print("mmHg");
      lcd.setCursor(13,1);
      lcd.print((int)(WiFi.RSSI()));
      delay(4000);
      break;
    default:
      Serial.println("Display definition error (main loop)");
      break;
    }
  }

  pressure=0; // атмосферное давление
  temp=0; // температура
  hum=0; // влажность
  
    if (!bme.begin(BME280_ADDRESS)) 
      {
        oled.print(F("Error     ")); //если датчик не найден - выводим ошибку и номер входа мультиплексора, к которому подключен неисправный датчик
        while (1);
      }
    bme.setSampling(Adafruit_BME280::MODE_NORMAL,   //режим работы датчика bme280
                  Adafruit_BME280::SAMPLING_X2,   //точность изм. температуры  
                  Adafruit_BME280::SAMPLING_X16,  //точность изм. давления 
                  Adafruit_BME280::SAMPLING_X2,  //точность изм. влажности 
                  Adafruit_BME280::FILTER_X16,    //уровень фильтрации
                  Adafruit_BME280::STANDBY_MS_0_5); //период просыпания, мСек
      
    pressure=bme.readPressure()/mmHg;  //сумма значений атмосферного давления 
    temp=bme.readTemperature();      //сумма значений температуры
    hum=bme.readHumidity();

  
  //передача пакета данных json раз в минуту в базу данных вуза
  //вывод на lcd-экран и в монитор порта название точки доступа, к которой удалось подключиться и ip-адреса раз в минуту
  //if (mnt!=old_time){sendJsonToDB(); lcd_v(); old_time=mnt;}
  //else {old_time=mnt;}

  //apsI0gqvFn
  //проверка/переподключение к сети wi-fi раз в 5 минут
  unsigned long mls;
  unsigned long mls_t;
  mls=millis();
  mls_t=mls%PERIOD;

  if(mls_t<oldmillis)
  {
   ReinitWiFi(1);
   oldmillis=mls_t;
  }


  if (millis() - when >= 60000)
  {
    when = millis();
    sendJsonToDB(); 
   lcd_v();
  }
  HTTP.handleClient();
  delay(1);
  WiFiClient client = SERVERaREST.available();
  if (!client) 
  {
    return;
  }
  while (!client.available()) 
  {
    delay(1);
  }
  rest.handle(client);
}
